/**************************************************************************//**
 *
 * @file inputs.c
 *
 * @author (TYPE YOUR NAME HERE)
 * @author (TYPE YOUR PARTNER'S NAME HERE, IF APPLICABLE)
 *
 * @brief Interrupt Service Routines for timer interrupts and pin change
 *      interrupts
 *
 ******************************************************************************/

/*
 * InterruptLab (c) 2021-23 Christopher A. Bohn
 * Number Pad Texter (c) 2023 Christopher A. Bohn
 * Number Pad Texter / InterruptLab solution (c) the above-named student
 *
 * Assignment and starter code licensed under the Apache License,
 * Version 2.0 (http://www.apache.org/licenses/LICENSE-2.0).
 */

#include <CowPi.h>
#include "inputs.h"
#include "character_selector.h"
#include "message_editor.h"


void handle_keypad(void);
void handle_right_button(void);
void handle_left_button(void);
void reset_timers(void);

volatile cowpi_timer16bit_t *character_timer;
volatile cowpi_timer8bit_t *led_timer;
volatile uint8_t supplemental_counter;


/**
 * Registers ISR for pin change interrupts, configures timers, and enables timer interrupts.
 */
void initialize_interrupts(void) {
    ;
}

/**
 * Sets timer counters and the supplemental counter to 0.
 */
void reset_timers(void) {
    supplemental_counter = 0;
    /* UNCOMMENT THE NEXT LINE DURING SECTION 4.5.1 */
//    led_timer->counter = 0;
    /* UNCOMMENT THE NEXT LINE DURING SECTION 5.2.3 */
//    character_timer->counter = 0;
}


ISR(TIMER2_COMPA_vect) {
    ;
}

/**
 * ISR to handle pin change interrupts generated by the matrix keypad.
 */
void handle_keypad(void) {
    debounce_interrupt({
        static char debounce_key = 0xF0;
        char key;
        while ((key = cowpi_get_keypress()) == debounce_key) {}     // busy-wait through the race condition
        debounce_key = key;
        /* YOUR CODE GOES HERE */


    });
}

/**
 * ISR to handle pin change interrupts generated by the right pushbutton.
 */
void handle_right_button(void) {
    debounce_interrupt({
        static bool debounce_is_pressed = false;
        bool is_pressed;
        while ((is_pressed = cowpi_right_button_is_pressed()) == debounce_is_pressed) {}    // busy-wait through the race condition
        debounce_is_pressed = is_pressed;
        /* YOUR CODE GOES HERE */


    });
}

/**
 * ISR to handle pin change interrupts generated by the left pushbutton.
 */
void handle_left_button(void) {
    debounce_interrupt({
        static bool debounce_is_pressed = false;
        bool is_pressed;
        while ((is_pressed = cowpi_left_button_is_pressed()) == debounce_is_pressed) {}     // busy-wait through the race condition
        debounce_is_pressed = is_pressed;
        /* YOUR CODE GOES HERE */


    });
}
